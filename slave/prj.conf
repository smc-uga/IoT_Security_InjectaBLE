## CMakeLists.txt
```
# SPDX-License-Identifier: Apache-2.0

cmake_minimum_required(VERSION 3.20.0)
find_package(Zephyr REQUIRED HINTS $ENV{ZEPHYR_BASE})
project(slave)

target_sources(app PRIVATE
  src/main.c
  src/led_svc.c
)
```

## prj.conf
```kconfig
CONFIG_BT=y
CONFIG_BT_PERIPHERAL=y
CONFIG_LOG=y
CONFIG_BT_HCI_ERR_TO_STR=y
CONFIG_BT_PRIVACY=n

# legacy advertising
CONFIG_BT_EXT_ADV=n
CONFIG_BT_CTLR_ADV_EXT=n
CONFIG_BT_CTLR_ADV_INDICATION=n

# Disable BLE 5 stuff
CONFIG_BT_DATA_LEN_UPDATE=n
CONFIG_BT_PHY_UPDATE=n
CONFIG_BT_CTLR_PHY_2M=n
CONFIG_BT_CTLR_PHY_CODED=n


CONFIG_BT_GATT_CLIENT=n
CONFIG_BT_GATT_DYNAMIC_DB=y

CONFIG_BT_GATT_CACHING=n
CONFIG_BT_KEYS_OVERWRITE_OLDEST=n
```

## src/main.c
```c
#include <zephyr/kernel.h>
#include <zephyr/logging/log.h>
LOG_MODULE_REGISTER(ble_slave, LOG_LEVEL_INF);
#include <string.h>

#include <zephyr/bluetooth/bluetooth.h> // BLE: Advertising/Connecting with GAP
#include <zephyr/bluetooth/gatt.h> // GATT: Service & Characteristic (LED on/off)
#include <zephyr/bluetooth/hci.h> // Included for the 'bt_hci_err_to_str' function

#include "led_svc.h"

ssize_t recv(struct bt_conn *conn, const struct bt_gatt_attr *attr,
             const void *buf, uint16_t len, uint16_t offset, uint8_t flags) {

  if (len <= 0) {
    LOG_ERR("GATT SERVER FAILED TO RECEIVE ANY BYTES FROM CLIENT");
    return BT_GATT_ERR(BT_ATT_ERR_INVALID_ATTRIBUTE_LEN);
  }

  uint8_t on_off = ((uint8_t *)buf)[0];
  led_update((int)on_off);
  return BT_GATT_ERR(BT_ATT_ERR_SUCCESS);
}

// iot_svc: defines the high level service
// led_char: defines a characteristic within that service
static const struct bt_uuid_16 iot_svc_uuid = BT_UUID_INIT_16(0xFFAA);
static const struct bt_uuid_16 led_char_uuid = BT_UUID_INIT_16(0xFFAB);

// iot_svc: Top Level Service that is exposed to Connected Device
// led_char: Field accessible by connected device (part of exposed service)
BT_GATT_SERVICE_DEFINE(iot_svc,

                       BT_GATT_PRIMARY_SERVICE(&iot_svc_uuid),

                       BT_GATT_CHARACTERISTIC(&led_char_uuid.uuid, 0,
                                              BT_GATT_PERM_WRITE, NULL, recv,
                                              (void *)1));

/************************************/
/***** Start BLE Advertisement ******/
/************************************/
int advertise(void) {

  uint8_t uuid[] = {0xFF, 0xBC}; // 16-bit UUID
  const char *scan_name = "Slave";

  const struct bt_data ad[] = {
      BT_DATA(BT_DATA_UUID16_SOME, uuid, sizeof(uuid)),
  };
  const struct bt_data sd[] = {
      BT_DATA(BT_DATA_NAME_COMPLETE, scan_name, strlen(scan_name)),
  };

  // Do BLE Advertisement until Connection is Established, then stop
  return bt_le_adv_start(BT_LE_ADV_CONN_FAST_1, ad, ARRAY_SIZE(ad), sd,
                         ARRAY_SIZE(sd));
}

int start_ble(void) {
  int err = advertise();
  if (err) {
    LOG_ERR("Failed to Start Advertising: (err = %d)", err);
  } else {
    LOG_INF("Started Advertising!");
  }
  return err;
}

/************************************/
/******* CONNECTION callbacks *******/
/************************************/
struct bt_conn *ble_conn;

static void connected(struct bt_conn *conn, uint8_t err) {

  if (err) {
    LOG_ERR("Connection failed, err 0x%02x %s\n", err, bt_hci_err_to_str(err));
  } else {
    LOG_INF("Connected");
    if (!ble_conn) {
      ble_conn = bt_conn_ref(conn);
    }
  }
}

static void disconnected(struct bt_conn *conn, uint8_t reason) {
  if (ble_conn) {
    bt_conn_unref(ble_conn);
    ble_conn = NULL;
  }

  LOG_INF("Disconnected, reason %u %s", reason, bt_hci_err_to_str(reason));
}

// Catch the disconnection (specifically, the newly free'd connection object)
static void restart_adv(void) {
  // Restart advertising
  int err = advertise();
  if (err) {
    LOG_ERR("Failed to restart advertising: err = %d", err);
  } else {
    LOG_INF("Re-advertising after disconnect");
  }
}

// Setup connection callbacks
BT_CONN_CB_DEFINE(conn_callbacks) = {
    .connected = connected,
    .disconnected = disconnected,
    .recycled = restart_adv,
};

/************************************/
/******* Main APP Entry Point *******/
/************************************/
int main(void) {

  // Initialize LED
  int err = led_init();
  if (err) {
    LOG_ERR("LED Failed to Initialized");
    return err;
  }

  // BLE init
  err = bt_enable(NULL);
  if (err) {
    LOG_ERR("Bluetooth Failed to Initialized");
    return err;
  }
  LOG_INF("Bluetooth Initialized");

  // BLE Advertise (stops advertising on connection)
  err = start_ble();
  if (err) {
    LOG_ERR("Failed to Start BLE");
    return err;
  }

  // Main Thread Sleep... no exit
  LOG_INF("Main Sleeping Forever...");
  k_sleep(K_FOREVER);
  return 0;
}
```

## src/led_svc.c
```c
/*
 * Copyright (c) 2019 Marcio Montenegro <mtuxpe@gmail.com>
 *
 * SPDX-License-Identifier: Apache-2.0
 */

#include <zephyr/drivers/gpio.h>
#include <zephyr/kernel.h>
#include <zephyr/logging/log.h>
LOG_MODULE_REGISTER(led_svc);

#include "led_svc.h"

static const struct gpio_dt_spec led = GPIO_DT_SPEC_GET(DT_ALIAS(led0), gpios);
static bool
    led_state; /* Tracking state here supports GPIO expander-based LEDs. */
static bool led_ok;

void led_update(int on_off) {
  if (!led_ok) {
    return;
  }

  led_state = ((on_off == 1) ? true : false);
  LOG_INF("Turn %s LED", led_state ? "on" : "off");
  gpio_pin_set(led.port, led.pin, led_state);
}

int led_init(void) {
  int ret;

  led_ok = gpio_is_ready_dt(&led);
  if (!led_ok) {
    LOG_ERR("Error: LED on GPIO %s pin %d is not ready", led.port->name,
            led.pin);
    return -ENODEV;
  }

  ret = gpio_pin_configure_dt(&led, GPIO_OUTPUT_INACTIVE);
  if (ret < 0) {
    LOG_ERR("Error %d: failed to configure GPIO %s pin %d", ret, led.port->name,
            led.pin);
  }

  return ret;
}
```

## src/led_svc.h
```c
/*
 * Copyright (c) 2019 Marcio Montenegro <mtuxpe@gmail.com>
 *
 * SPDX-License-Identifier: Apache-2.0
 */

#ifndef IOT_LED_SVC_H_
#define IOT_LED_SVC_H_

void led_update(int on_off);
int led_init(void);

#endif // IOT_LED_SVC_H_
```
